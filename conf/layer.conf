## conf/machine/de10-standard.conf
```bitbake
#@TYPE: Machine
#@NAME: DE10-Standard
#@DESCRIPTION: Machine configuration for the Terasic DE10-Standard Cyclone V SoC

require conf/machine/include/socfpga.inc
require conf/machine/include/ubifs.inc

SPL_BINARY = "spl/u-boot-splx4.sfp"
UBOOT_BINARY = "u-boot.img"

UBOOT_CONFIG ??= "de10-standard"
UBOOT_CONFIG[de10-standard] = "socfpga_de10_standard_defconfig"

KMACHINE = "cyclone5"

KERNEL_DEVICETREE ?= "intel/socfpga/socfpga_cyclone5_de10_standard.dtb"

SERIAL_CONSOLES ?= "115200;ttyS0"

UBOOT_EXTLINUX ?= "1"
UBOOT_EXTLINUX_LABELS ?= "default"
UBOOT_EXTLINUX_DEFAULT_LABEL ?= "Terasic DE10-Standard SDMMC"

UBOOT_EXTLINUX_CONSOLE ?= "console=ttyS0,115200n8"
UBOOT_EXTLINUX_ROOT:default ?= "root=/dev/mmcblk0p2"
UBOOT_EXTLINUX_MENU_DESCRIPTION:default ?= "Terasic DE10-Standard SDMMC"
UBOOT_EXTLINUX_KERNEL_IMAGE:default ?= "../${KERNEL_IMAGETYPE}"
UBOOT_EXTLINUX_FDTDIR:default ?= ".."
UBOOT_EXTLINUX_KERNEL_ARGS:default ?= "rootwait rw earlyprintk"

EXTRA_IMAGECMD:jffs2 ?= "-e 0x10000"

IMAGE_BOOT_FILES ?= " \
    socfpga_cyclone5_de10_standard.dtb \
    ${KERNEL_IMAGETYPE} \
    ${UBOOT_BINARY} \
    extlinux.conf;extlinux/extlinux.conf \
"

WKS_FILE ?= "sdimage-cyclone5-arria5.wks"
IMAGE_FSTYPES:append = " wic"
```
